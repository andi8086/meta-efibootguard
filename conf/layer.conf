## conf/layer.conf
```bitbake
BBPATH .= ":${LAYERDIR}"

BBFILES += "${LAYERDIR}/recipes-*/*/*.bb \
	${LAYERDIR}/recipes-*/*/*.bbappend"

BBFILE_COLLECTIONS += "efibootguard"
BBFILE_PATTERN_efibootguard = "^${LAYERDIR}/"
BBFILE_PRIORITY_efibootguard = "6"

EFIBOOTGUARD_GPLv2_LICENSE = "${LAYERDIR}/COPYING.GPLv2"
```
